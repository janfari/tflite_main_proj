## CMakeLists.txt
```
cmake_minimum_required(VERSION 3.20.0)

set(CONF_FILE "")
list(APPEND CONF_FILE
    ${CMAKE_CURRENT_SOURCE_DIR}/conf/prj.conf
    ${CMAKE_CURRENT_SOURCE_DIR}/conf/rtt.conf
    ${CMAKE_CURRENT_SOURCE_DIR}/conf/tf.conf
)

find_package(Zephyr REQUIRED HINTS $ENV{ZEPHYR_BASE})
project(tensorflow_hello_world)

# These samples use local static initialization. Since Zephyr doesn't support the
# C++ ABI for thread-safe initialization of local statics and the constructors don't
# appear to require thread safety, we turn it off in the C++ compiler.
set(NO_THREADSAFE_STATICS $<TARGET_PROPERTY:compiler-cpp,no_threadsafe_statics>)
zephyr_compile_options($<$<COMPILE_LANGUAGE:CXX>:${NO_THREADSAFE_STATICS}>)

target_sources(app PRIVATE ./src/main.cpp)
```

## Kconfig
```
menu "Zephyr"
source "Kconfig.zephyr"
endmenu

module = TF_LITE_TEST
module-str = tf lite test
source "subsys/logging/Kconfig.template.log_config"
```

## sample.yaml
```
sample:
  description: Hello World TensorFlow sample
  name: hello world tensorflow
common:
  tags: tensorflow
  modules:
    - tflite-micro
  harness: console
  harness_config:
    type: multi_line
    ordered: false
    regex:
      - "x_value:.*, y_value:.*"
      - ""
tests:
  sample.tensorflow.helloworld:
    tags: tensorflow
```

## prj.conf
```kconfig
#Tensor Flow Lit Micro
CONFIG_CPP=y
CONFIG_TENSORFLOW_LITE_MICRO=y
CONFIG_STD_CPP17=y

# RTT 
CONFIG_USE_SEGGER_RTT=y
CONFIG_RTT_CONSOLE=y
CONFIG_UART_CONSOLE=n
CONFIG_LOG_BACKEND_SHOW_COLOR=y
CONFIG_SEGGER_RTT_BUFFER_SIZE_UP=2048
# Shell
CONFIG_SHELL=y
CONFIG_SHELL_BACKEND_SERIAL=n
CONFIG_SHELL_BACKEND_RTT=y

# # # # BAD
# CONFIG_BOOTLOADER_MCUBOOT=y
# CONFIG_BT=y 
# # # # BAD
```

## src/main.c
```c
/*
 * Copyright 2020 The TensorFlow Authors. All Rights Reserved.
 *
 * Licensed under the Apache License, Version 2.0 (the "License");
 * you may not use this file except in compliance with the License.
 * You may obtain a copy of the License at
 *
 *     http://www.apache.org/licenses/LICENSE-2.0
 *
 * Unless required by applicable law or agreed to in writing, software
 * distributed under the License is distributed on an "AS IS" BASIS,
 * WITHOUT WARRANTIES OR CONDITIONS OF ANY KIND, either express or implied.
 * See the License for the specific language governing permissions and
 * limitations under the License.
 */
#include <zephyr/kernel.h>

#include <main_functions.h>


/* Increase number of loops to see full period of the sine curve */
#define NUM_LOOPS 10

/* This is the default main used on systems that have the standard C entry
 * point. Other devices (for example FreeRTOS or ESP32) that have different
 * requirements for entry code (like an app_main function) should specialize
 * this main.cc file in a target-specific subfolder.
 */
int main(int argc, char *argv[])
{
	printk("Hello World! %s\n", CONFIG_BOARD);

	setup();
	/* Note: Modified from original while(true) to accommodate CI */
	for (int i = 0; i < NUM_LOOPS; i++) {
		loop();
	}
	return 0;
}
```

## src/main.cpp
```c
/*
 * Copyright 2020 The TensorFlow Authors. All Rights Reserved.
 *
 * Licensed under the Apache License, Version 2.0 (the "License");
 * you may not use this file except in compliance with the License.
 * You may obtain a copy of the License at
 *
 *     http://www.apache.org/licenses/LICENSE-2.0
 *
 * Unless required by applicable law or agreed to in writing, software
 * distributed under the License is distributed on an "AS IS" BASIS,
 * WITHOUT WARRANTIES OR CONDITIONS OF ANY KIND, either express or implied.
 * See the License for the specific language governing permissions and
 * limitations under the License.
 */
#include <zephyr/kernel.h>

#include <main_functions.h>


/* Increase number of loops to see full period of the sine curve */
#define NUM_LOOPS 10

/* This is the default main used on systems that have the standard C entry
 * point. Other devices (for example FreeRTOS or ESP32) that have different
 * requirements for entry code (like an app_main function) should specialize
 * this main.cc file in a target-specific subfolder.
 */
int main(int argc, char *argv[])
{
	printk("Hello World! %s\n", CONFIG_BOARD);

	tf_subpj_setup();
	/* Note: Modified from original while(true) to accommodate CI */
	for (int i = 0; i < NUM_LOOPS; i++) {
		tf_subpj_loop();
	}
	return 0;
}
```
